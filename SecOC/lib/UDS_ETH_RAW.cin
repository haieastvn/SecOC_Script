/*@!Encoding:1252*/
includes
{
 #include"Basic.cin"
}

variables
{
  //
  byte Req_22F1AE[3]={0x22,0xF1,0xAE};
  byte Resp_62F1AE[3]={0x62,0xF1,0xAE};
  byte Req_34[11]={0x34};
  byte Resp_74[11]={0x74};
  byte Req_36_TCP[1500]={0x0E,0x80,0x10,0x15,0x36};
  byte Resp_76[2]={0x76};
  byte Req_37[1]={0x37};
  byte Resp_77[1]={0x77};
  //Tester present
  byte Req_3E00[2]= {0x3E,0x00};
  //Session
  byte Req_1001[2]= {0x10,0x01};
  byte Resp_5001[2] = {0x50, 0x01};
  byte Req_1002[2]= {0x10,0x02};
  byte Resp_5002[2] = {0x50, 0x02};
  byte Req_1003[2]= {0x10,0x03};
  byte Resp_5003[2] = {0x50, 0x03};
  byte Req_1082[2]= {0x10,0x82};
  //Reset
  byte Req_1101[2]= {0x11,0x01};
  byte Resp_5101[2] = {0x51, 0x01};
  byte Req_1181[2]= {0x11,0x81};
  //19
  byte Req_14FFFFFF[4]={0x14,0xFF,0xFF,0xFF};
  byte Req_190209[3] = {0x19,0x02,0x09};
  byte Resp_5902[100]={0x59,0x02};
  byte Req_1904FF[6] = {0x19,0x04,0x00,0x00,0x00,0xFF};
  byte Resp_5904[2] ={0x59,0x04};
  //31
  byte Req_31010301[8] = {0x31,0x01,0x03,0x01,0x95,0x3F,0xF0,0x00};
  byte Resp_71010301[4] = {0x71,0x01,0x03,0x01};
  //2e
  byte Req_2ED01C[295] ={0x2e,0xD0,0x1C,0xB7,0xE9,0x74,0x4B,0x45,0xFA,0xA6,0x20,0xD3,0x1C,0x30,0xE9,0x63,0x86,0xE9,0xCD,0x5F,0xB9,0x93,0xDE,0xCA,0x45,0xC9,0xD6,0x8,0x94,0xF7,0x7D,0xB9,0xEE,0xA9,0xD0,0x78,0x45,0x76,0x94,0x80,0x9D,0xF7,0x5,0x24,0xD7,0x30,0xE2,0xC0,0x0F,0x4,0x6E,0x60,0x53,0x23,0xBD,0x50,0x3,0xBF,0x2C,0xA9,0xBB,0xB4,0x5C,0xC5,0x11,0x5A,0x1D,0xCE,0x25,0x7D,0x42,0x3,0x4F,0x7E,0x1C,0x7A,0x3E,0x1A,0x68,0xE8,0x9A,0x0,0x10,0x8D,0x18,0x28,0xAC,0x26,0xBD,0x71,0xAE,0x4A,0xC9,0xB9,0x23,0x0B,0x9B,0xC1,0x1,0x67,0x46,0xA9,0x1,0x5E,0x70,0xF1,0xD9,0xBD,0x7F,0x56,0x4B,0x97,0x61,0x64,0xFF,0xC1,0xD9,0x6E,0x93,0xAB,0x40,0x66,0xD5,0xCB,0xF4,0x2,0xF5,0xFC,0x53,0x11,0x51,0xA9,0x80,0x5C,0x7,0x16,0xAB,0xCB,0x98,0x25,0xFE,0x2,0xF3,0x89,0x7E,0x57,0x91,0x7A,0x64,0xCC,0x2C,0x7A,0x71,0xE8,0x83,0x33,0x59,0x0A,0xA9,0x59,0x23,0xCF,0x4A,0x6B,0xE4,0x24,0x1A,0xF7,0x8C,0xA9,0x4,0x5D,0x65,0xB6,0x74,0x87,0x19,0x42,0x49,0xE3,0x69,0x3,0xDD,0xA4,0xC9,0x75,0xFE,0xA7,0x3C,0x7,0xC1,0x91,0x67,0x54,0x45,0xFE,0x5F,0xCF,0x45,0x72,0xF8,0xBD,0x47,0x95,0xBA,0x81,0xA7,0x54,0x50,0x55,0x29,0x92,0x2F,0x81,0x82,0x71,0x9B,0x43,0x1C,0xEB,0x27,0x16,0xCA,0x87,0xE2,0xBA,0x83,0xA0,0x1E,0x85,0xEF,0x75,0xE4,0x63,0x88,0x2D,0x0B,0x53,0x76,0xB6,0xB3,0xD6,0x68,0x19,0xE2,0x6C,0x2B,0x67,0x4F,0x0A,0x9D,0xDE,0xFE,0x93,0x42,0x43,0xCE,0x87,0xAD,0x0,0x1,0x0,0x1,0x31,0xdd,0xd9,0xec,0x24,0x20,0x1a,0x6a,0x82,0x5d,0x84,0x2,0x18,0x60,0x9a,0xab,0x65,0xb0,0x4e,0xfa,0x44,0xa0,0x4a,0x99,0x12,0xf4,0xba,0xe8,0xe6,0x91,0xbb,0x9c};
  byte Resp_6ED01C[3]= {0x6E,0xD0,0x1C};
  byte Req_2EF104[7]={0x2e,0xf1,0x04,0x00,0x00,0x00,0x00};
  //27
  byte Req_2719[2]= {0x27,0x19};
  byte Resp_671A[2]= {0x67,0x1A};
  byte Resp_6719[2]= {0x67,0x19};
  
  byte Req_2701[2]= {0x27,0x01};
  byte Resp_6701[2]= {0x67,0x01};
  byte Resp_6702[2]= {0x67,0x02};
  
  byte Req_2705[2]= {0x27,0x05};
  byte Resp_6705[2]= {0x67,0x05};
  byte Resp_6706[2]= {0x67,0x06};
  
  byte Req_2703[2]= {0x27,0x03};
  byte Resp_6703[ 2]= {0x67,0x03};
  byte Resp_6704[ 2]= {0x67,0x04};

  byte Resp_7F2735[ 3]= {0x7F,0x27,0x35};
  byte Resp_7F2736[ 3]= {0x7F,0x27,0x36};
  byte Resp_7F2737[ 3]= {0x7F,0x27,0x37};
  //22
  byte Resp_7F2231[3]= {0x7F,0x22,0x31};
  
  byte Req_22f186[3] = {0x22,0xf1,0x86};
  byte Resp_62f186[3] = {0x62,0xf1,0x86};
  byte Resp_62f18601[4] = {0x62,0xf1,0x86,01};
  byte Resp_62f18602[4] = {0x62,0xf1,0x86,02};
  byte Resp_62f18603[4] = {0x62,0xf1,0x86,03};
  byte Req_22C00A[3]= {0x22,0xC0,0x0A};
  byte Resp_62C00A[3]= {0x62,0xC0,0x0A};
  byte Req_22C00F[3]= {0x22,0xC0,0x0F};
  byte Resp_62C00F[3]= {0x62,0xC0,0x0F};
  byte Req_22C00B[3]= {0x22,0xC0,0x0B};
  byte Resp_62C00B[3]= {0x62,0xC0,0x0B};
  
  byte Req_22C00E[3]= {0x22,0xC0,0x0E};
  byte Resp_62C00E[3]= {0x62,0xC0,0x0E};
  
  byte Req_22D00C[3]= {0x22,0xD0,0x0C};
  byte Resp_62D00C[3]= {0x62,0xD0,0x0C};
  
  byte Req_22C00C[3]= {0x22,0xC0,0x0C};
  byte Resp_62C00C[3]= {0x62,0xC0,0x0C};
  byte Req_22C00D[3]= {0x22,0xC0,0x0D};
  byte Resp_62C00D[3]= {0x62,0xC0,0x0D};
  byte Req_22C013[3]= {0x22,0xC0,0x13};
  byte Resp_62C013[3]= {0x62,0xC0,0x13};
  byte Req_22D01C[3]= {0x22,0xD0,0x1C};
  byte Resp_62D01C[3]= {0x62,0xD0,0x1C};
//7f
  byte  Resp_7F[1]={0x7F};
  //Fix length
  char str_DOIP_packet[1500];
  byte datadoip[1500];
  byte UDS_Data[1500];
  dword lendoip;
  byte Data_DoIP_packet[1000];
  byte Snapshot[8];
  byte StartDID;
}

export testfunction Check_DTC_ETH_RAW(long Timeout, byte SrcAddr[], byte DesAddr[], byte DTCs[])
{
  byte expectdata[1500];
  long rel;
  byte i;
  char str[1500]; 
  char str_DTC[1500];
  byte UdsData[6]={0x0E,0x80,0x10,0x15,0x59,0x02};
  byte expecttdata2[1500];
  dword lendoip;
  L4Protocol = kTcp; 
  memcpy_off(expectdata, 0, SrcAddr, 0, 2);
  memcpy_off(expectdata, 2, DesAddr, 0, 2); 
  memcpy_off(expectdata, 4, UdsData, 0,  elCount(UdsData)); 
  expectLen = 4 + elCount(UdsData);
  ByteArray_To_String(expectdata, expectLen, str);
  memcpy_off(expecttdata2, 0, DTCs, 0,  elCount(DTCs)); 
  ByteArray_To_String(expecttdata2, elCount(DTCs), str_DTC);
  testStep("WaitForDiagnosticMessageResp", "Expect receive diagnostic message: %s", str);
  rel = testWaitForTextEvent(Diagmsg, Timeout);
  if (rel==1)
  {
    testStep("Check DTC"," Expect DTC: %s",str_DTC);
    for (i=0;i<255;i++)
    {
      if(datadoip[i]==DTCs[0] &&datadoip[i+1]==DTCs[1]&&datadoip[i+2]==DTCs[2] &&datadoip[i+3]==0x2F)
      {
        testStepPass("Check DTC", "Exist DTC: %s 2F",str_DTC);
        rel=0;
        break;
      }
    }
    if(rel==1)  testStepFail("Check DTC", "Don't Exist DTC: %s 2F",str_DTC);
  }
  else
   testStepFail("WaitForDiagnosticMessageResp", "Diagnostic no reply");
}
void Add_DTC_1904(byte DTCs[])
{
  Req_1904FF[2]=DTCs[0];
  Req_1904FF[3]=DTCs[1];
  Req_1904FF[4]=DTCs[2];
}
export testfunction Return_Snap_shot(long Timeout, byte DID[])
{
  long rel;
  long j,i;
  byte expecttdata2[1500];
  char str_snapshot[1500];
    char str_data_DID[100];
  char str_DID[10];
  rel=testWaitForTextEvent(Diagmsg, Timeout);
  ByteArray_To_String(DID, elcount(DID), str_DID);

  if(rel==1)
  {
    testStepPass("WaitForDiagnosticMessageResp", "Diagnostic Packet:%s ",str_DOIP_packet);
    rel=0;
     for (i=0;i<255;i++)
    {
      if(datadoip[i]==DID[0] && datadoip[i+1]==DID[1])
      {
        rel=1;
        StartDID=i;     
      }
    }
      if(rel==1)
    {
      
        for (i=StartDID;i<StartDID+8;i++)
        {    
          Snapshot[i-StartDID]=datadoip[i-2+4] ;      
        }
        ByteArray_To_String(Snapshot, elcount(Snapshot), str_data_DID);
       testStepPass("DIDSnapshot", "Found %s %s",str_DID,str_data_DID);
    }
    else
    {
      testStepFail("DIDSnapshot", "Not Found %s",str_DID);
    }
  }
  else
  {
    testStepFail("WaitForDiagnosticMessageResp", "Diagnostic no reply");
  }
  
  
}
int getBit(int number, int position) {
  byte bitValue ;
  dword shiftedNumber;
    // Shifting the bit at the desired position to the rightmost bit
 shiftedNumber = number >> position; // Shifting the bit at the desired position to the rightmost bit
  bitValue= shiftedNumber & 0x01;
////
    return bitValue;
}
