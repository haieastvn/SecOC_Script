/*@!Encoding:936*/
includes
{
  #include "Basic.cin"
}

variables
{
  byte payload[8192];
  byte DiagMsgNormalModeReq[2]={0x10,0x01};
  byte DiagMsgResetReq[2]={0x11,0x01};
  byte tempLongDate[1920*4];
  byte DiagMsgNACKModeReq[2]={0x10,0x99};
  byte Temp[7]={0x2F,01,00,03,00,00,01};
  byte DiagMsgNormalModeReq_1[8]={0x23,0x24,0xAF,0x00,0x00,0x00,0xFF,0xF0};
  byte DiagMsgNormalModeReq_2[2]={0x3E,0x80};
  byte DiagMsgNormalModeReq_3[2]={0x10,0x82};
  msTimer tmr;
//  dword gDoIPIntSocket;
  byte DiagMsgSecLv1_2[5]={0x27,0x02, 0x00, 0x00, 0x00};
  byte DiagMsgSecLv5_6[5]={0x27,0x06, 0x00, 0x00, 0x00};
  byte DiagMsgSecLv19_1A[5]={0x27,0x1A, 0x00, 0x00, 0x00};
  msTimer tmr_01_02;
  msTimer tmr_05_06;
  msTimer tmr_19_1A;
  byte  i = 0;
	byte  j = 0;
  byte u8_s_ChangeBitList_FixByte_Seed_01_02[8] = { 0xFF, 0xFF, 0xFF, 0xFF, 0xFF, 0x00, 0x00, 0x00 };
  byte u8_s_ChangeBitList_FixByte_Seed_05_06[8] = { 0x35, 0xC5, 0x2E, 0xDB, 0x4A, 0x00, 0x00, 0x00 };
  byte u8_s_ChangeBitList_FixByte_Seed_19_1A[8] = { 0xFF, 0xFF, 0xFF, 0xFF, 0xFF, 0x00, 0x00, 0x00 };
  dword u32_s_PositionA = 0xC541A9;
  dword u32_s_PositionB = 0x0;
  dword u32_s_PositionC = 0x0;
  dword u32_s_PositionC21 = 0x0;
  dword u32_s_PositionC16 = 0x0;
  dword u32_s_PositionC13 = 0x0;
  dword u32_s_PositionC6 = 0x0;
  dword u32_s_PositionC4 = 0x0;
  
  
  ///
  
  byte Unlock_191A=1;
  byte Unlock_0506=1;
  byte Unlock_0102=1;
}

//on start
//{
//  word i =0;
//  for(i=0;i<1920*4;i++)
//  {
//    tempLongDate[i]=(byte)(i%0xFF);
//  }
//}
on preStart 
{
  word i =0;
  for(i=0;i<1920*4;i++)
  {
    tempLongDate[i]=(byte)(i%0xFF);
  }
  Unlock_191A=1;
  Unlock_0506=1;
  Unlock_0102=1;
}

Send_Diagnostic_Msg(word SA,word DA,byte UserData[],word Length)
{
  long result;
  word i=0;  
  payload[0] = 0x02;
  payload[1] = 0xfd;
  payload[2] = 0x80;
  payload[3] = 0x01;
  payload[4] = 0x00;
  payload[5] = 0x00;
  payload[6] = (byte)(Length>>8);
  payload[7] = (byte)Length;
  payload[8] = (byte)(SA>>8);
  payload[9] = (byte)SA;
  payload[10] = (byte)(DA>>8);
  payload[11] = (byte)DA;
  for(i=0;i<(Length-4);i++)
    payload[12+i] = UserData[i];
  
  result = TcpSend(TcpSocket[0],payload,Length+8);
  if(result == -1){
    result = IpGetLastSocketError(TcpSocket[0]);
	write("%d",result);
  }
}

Send_Diagnostic_2EMsg(word SA,word DA,word DID,byte UserData[],word Length)
{
  word i=0;  
  payload[0] = 0x02;
  payload[1] = 0xfd;
  payload[2] = 0x80;
  payload[3] = 0x01;
  payload[4] = 0x00;
  payload[5] = 0x00;
  payload[6] = (byte)(Length>>8);
  payload[7] = (byte)Length;
  payload[8] = (byte)(SA>>8);
  payload[9] = (byte)SA;
  payload[10] = (byte)(DA>>8);
  payload[11] = (byte)DA;
  payload[12] = 0x2E;
  payload[13] = (byte)(DID>>8);
  payload[14] = (byte)DID;
  for(i=0;i<(Length-7);i++)
    payload[15+i] = UserData[i];
  
  tcpSend(TcpSocket[0],payload,Length+8);
  
}



void SecurityAccess_Calc_Key_LV1(byte ipSeedArray[], byte iSeedArraySize, byte iopKeyArray[])
{
  i = 0;
  j = 0;
  u32_s_PositionA = 0xC541A9;
  u32_s_PositionB = 0x0;
  u32_s_PositionC = 0x0;
  u32_s_PositionC21 = 0x0;
  u32_s_PositionC16 = 0x0;
  u32_s_PositionC13 = 0x0;
  u32_s_PositionC6 = 0x0;
  u32_s_PositionC4 = 0x0;
  
  u8_s_ChangeBitList_FixByte_Seed_01_02[5] = ipSeedArray[2];
  write ("ipSeedArray[2] %X",ipSeedArray[2]);
  u8_s_ChangeBitList_FixByte_Seed_01_02[6] = ipSeedArray[1];
  write ("ipSeedArray[1] %X",ipSeedArray[1]);
  u8_s_ChangeBitList_FixByte_Seed_01_02[7] = ipSeedArray[0];
  write ("ipSeedArray[0] %X",ipSeedArray[0]);

  
  for(j= 8;j>0;j--){
    
   // write ("J %X",j);
    for(i =0;i<8;i++){
      
     // write ("I %X",i);
      
      u32_s_PositionB = ((u32_s_PositionA &0x01)^ ((u8_s_ChangeBitList_FixByte_Seed_01_02[j-1]>>i)&0x01));
      //write ("u32_s_PositionB %X",u32_s_PositionB& 0xffffff);
      u32_s_PositionB = (u32_s_PositionB<<23)&0x800000;
      //write ("u32_s_PositionB %X",u32_s_PositionB& 0xffffff);
      u32_s_PositionB = ((u32_s_PositionA>>1) & 0xffffff) + u32_s_PositionB ;
      //write ("u32_s_PositionB %X",u32_s_PositionB& 0xffffff);
      u32_s_PositionC = u32_s_PositionB;
      u32_s_PositionC21 = ((u32_s_PositionB>>23)&0x1)^ ((u32_s_PositionB>>20)&0x1);
      u32_s_PositionC16 = ((u32_s_PositionB>>23)&0x1)^ ((u32_s_PositionB>>15)&0x1);
      u32_s_PositionC13 = ((u32_s_PositionB>>23)&0x1)^ ((u32_s_PositionB>>12)&0x1);
      u32_s_PositionC6 = ((u32_s_PositionB>>23)&0x1)^ ((u32_s_PositionB>>5)&0x1);
      u32_s_PositionC4 = ((u32_s_PositionB>>23)&0x1)^ ((u32_s_PositionB>>3)&0x1);
      //write("%X",(u32_s_PositionB>>20)&0x1);
      
      if((u32_s_PositionB>>20)&0x1){
        u32_s_PositionC = u32_s_PositionC &((u32_s_PositionC21<<20)|0xEFFFFF);
        
      }else{
        u32_s_PositionC = u32_s_PositionC |((u32_s_PositionC21<<20));
      }
     // write ("u32_s_PositionC %X",u32_s_PositionC& 0xffffff);
      if((u32_s_PositionB>>15)&0x1){
        u32_s_PositionC = u32_s_PositionC &((u32_s_PositionC16<<15)|0xFF7FFF);
      }else{
        u32_s_PositionC = u32_s_PositionC |((u32_s_PositionC16<<15));
      }
      //write ("u32_s_PositionC %X",u32_s_PositionC& 0xffffff);
      if((u32_s_PositionB>>12)&0x1){
        u32_s_PositionC = u32_s_PositionC &((u32_s_PositionC13<<12)|0xFFEFFF);
      }else{
        u32_s_PositionC = u32_s_PositionC |((u32_s_PositionC13<<12));
      }
      //write ("u32_s_PositionC %X",u32_s_PositionC& 0xffffff);
      if((u32_s_PositionB>>5)&0x1){
        u32_s_PositionC = u32_s_PositionC &((u32_s_PositionC6<<5)|0xFFFFDF);
      }else{
        u32_s_PositionC = u32_s_PositionC |((u32_s_PositionC6<<5));
      }
      //write ("u32_s_PositionC %X",u32_s_PositionC& 0xffffff);
      if((u32_s_PositionB>>3)&0x1){
        u32_s_PositionC = u32_s_PositionC &((u32_s_PositionC4<<3)|0xFFFFF7);
      }else{
        u32_s_PositionC = u32_s_PositionC |((u32_s_PositionC4<<3));
      }
      //write ("u32_s_PositionC %X",u32_s_PositionC& 0xffffff);
      u32_s_PositionA = u32_s_PositionC;
      
    }
  }
 
    iopKeyArray[0] = (byte)((u32_s_PositionC >> 4)&0xff);
	iopKeyArray[1] = ((byte)(u32_s_PositionC >> 8) & 0xF0) | (byte)(u32_s_PositionC >> 20);
	iopKeyArray[2] = ((((byte)u32_s_PositionC) << 4) | ((byte)(u32_s_PositionC >> 16) & 0x0F));
	
  
  DiagMsgSecLv1_2[2] = iopKeyArray[0];
  DiagMsgSecLv1_2[3] = iopKeyArray[1];
  DiagMsgSecLv1_2[4] = iopKeyArray[2];
  
//  @Test::Key_Array_3_Bytes[0] = iopKeyArray[0];
//  @Test::Key_Array_3_Bytes[1] = iopKeyArray[1];
//  @Test::Key_Array_3_Bytes[2] = iopKeyArray[2];
//  
  
  write ("iopKeyArray %x %x %x", iopKeyArray[0], iopKeyArray[1], iopKeyArray[2]);
  write ("DiagMsgSecLv1_2 %x %x %x", DiagMsgSecLv1_2[2], DiagMsgSecLv1_2[3], DiagMsgSecLv1_2[4]);
    testStep("Security","Send 27 02 ");
////  if(@Test::Unlock_0102)
////  {
//    setTimer(tmr_01_02,50);
////  }
     if(Unlock_0102 == 1)
  {
      testStepPass("Security","Send 27 02 true key completely");
      setTimer(tmr_01_02,50);
  }
  else
  {
    testStepPass("Security","Send 27 02 wrong key completely");
    DiagMsgSecLv1_2[4] = 0;
    setTimer(tmr_01_02,50);
  }
}

void SecurityAccess_Calc_Key_LV5(byte ipSeedArray[], byte iSeedArraySize, byte iopKeyArray[])
{
  i = 0;
  j = 0;
  u32_s_PositionA = 0xC541A9;
  u32_s_PositionB = 0x0;
  u32_s_PositionC = 0x0;
  u32_s_PositionC21 = 0x0;
  u32_s_PositionC16 = 0x0;
  u32_s_PositionC13 = 0x0;
  u32_s_PositionC6 = 0x0;
  u32_s_PositionC4 = 0x0;
  
  u8_s_ChangeBitList_FixByte_Seed_05_06[5] = ipSeedArray[2];
  write ("ipSeedArray[2] %X",ipSeedArray[2]);
  u8_s_ChangeBitList_FixByte_Seed_05_06[6] = ipSeedArray[1];
  write ("ipSeedArray[1] %X",ipSeedArray[1]);
  u8_s_ChangeBitList_FixByte_Seed_05_06[7] = ipSeedArray[0];
  write ("ipSeedArray[0] %X",ipSeedArray[0]);

  
  for(j= 8;j>0;j--){
    
    for(i =0;i<8;i++){
      
      
      u32_s_PositionB = ((u32_s_PositionA &0x01)^ ((u8_s_ChangeBitList_FixByte_Seed_05_06[j-1]>>i)&0x01));
      u32_s_PositionB = (u32_s_PositionB<<23)&0x800000;
      u32_s_PositionB = ((u32_s_PositionA>>1) & 0xffffff) + u32_s_PositionB ;
      u32_s_PositionC = u32_s_PositionB;
      u32_s_PositionC21 = ((u32_s_PositionB>>23)&0x1)^ ((u32_s_PositionB>>20)&0x1);
      u32_s_PositionC16 = ((u32_s_PositionB>>23)&0x1)^ ((u32_s_PositionB>>15)&0x1);
      u32_s_PositionC13 = ((u32_s_PositionB>>23)&0x1)^ ((u32_s_PositionB>>12)&0x1);
      u32_s_PositionC6 = ((u32_s_PositionB>>23)&0x1)^ ((u32_s_PositionB>>5)&0x1);
      u32_s_PositionC4 = ((u32_s_PositionB>>23)&0x1)^ ((u32_s_PositionB>>3)&0x1);
      
      if((u32_s_PositionB>>20)&0x1){
        u32_s_PositionC = u32_s_PositionC &((u32_s_PositionC21<<20)|0xEFFFFF);
        
      }else{
        u32_s_PositionC = u32_s_PositionC |((u32_s_PositionC21<<20));
      }
      if((u32_s_PositionB>>15)&0x1){
        u32_s_PositionC = u32_s_PositionC &((u32_s_PositionC16<<15)|0xFF7FFF);
      }else{
        u32_s_PositionC = u32_s_PositionC |((u32_s_PositionC16<<15));
      }
      if((u32_s_PositionB>>12)&0x1){
        u32_s_PositionC = u32_s_PositionC &((u32_s_PositionC13<<12)|0xFFEFFF);
      }else{
        u32_s_PositionC = u32_s_PositionC |((u32_s_PositionC13<<12));
      }
      if((u32_s_PositionB>>5)&0x1){
        u32_s_PositionC = u32_s_PositionC &((u32_s_PositionC6<<5)|0xFFFFDF);
      }else{
        u32_s_PositionC = u32_s_PositionC |((u32_s_PositionC6<<5));
      }
      if((u32_s_PositionB>>3)&0x1){
        u32_s_PositionC = u32_s_PositionC &((u32_s_PositionC4<<3)|0xFFFFF7);
      }else{
        u32_s_PositionC = u32_s_PositionC |((u32_s_PositionC4<<3));
      }
      u32_s_PositionA = u32_s_PositionC;
      
    }
  }
 
    iopKeyArray[0] = (byte)((u32_s_PositionC >> 4)&0xff);
	iopKeyArray[1] = ((byte)(u32_s_PositionC >> 8) & 0xF0) | (byte)(u32_s_PositionC >> 20);
	iopKeyArray[2] = ((((byte)u32_s_PositionC) << 4) | ((byte)(u32_s_PositionC >> 16) & 0x0F));
	
  
  DiagMsgSecLv5_6[2] = iopKeyArray[0];
  DiagMsgSecLv5_6[3] = iopKeyArray[1];
  DiagMsgSecLv5_6[4] = iopKeyArray[2];
  
//  @Test::Key_Array_3_Bytes[0] = iopKeyArray[0];
//  @Test::Key_Array_3_Bytes[1] = iopKeyArray[1];
//  @Test::Key_Array_3_Bytes[2] = iopKeyArray[2];

  
  write ("iopKeyArray %x %x %x", iopKeyArray[0], iopKeyArray[1], iopKeyArray[2]);
  write ("DiagMsgSecLv1_2 %x %x %x", DiagMsgSecLv5_6[2], DiagMsgSecLv5_6[3], DiagMsgSecLv5_6[4]);
  testStep("Security","Send 27 06 ");
////  if(@Test::Unlock_0506 == 1)
////  {
//    setTimer(tmr_05_06,50);
////  }
    if(Unlock_0506 == 1)
  {
      testStepPass("Security","Send 27 06 true key completely");
      setTimer(tmr_05_06,50);
  }
  else
  {
    testStepPass("Security","Send 27 06 wrong key completely");
    DiagMsgSecLv5_6[4] = 0;
    setTimer(tmr_05_06,50);
  }
}

void SecurityAccess_Calc_Key_LV19(byte ipSeedArray[], byte iSeedArraySize, byte iopKeyArray[])
{
  i = 0;
  j = 0;
  u32_s_PositionA = 0xC541A9;
  u32_s_PositionB = 0x0;
  u32_s_PositionC = 0x0;
  u32_s_PositionC21 = 0x0;
  u32_s_PositionC16 = 0x0;
  u32_s_PositionC13 = 0x0;
  u32_s_PositionC6 = 0x0;
  u32_s_PositionC4 = 0x0;
  
  u8_s_ChangeBitList_FixByte_Seed_19_1A[5] = ipSeedArray[2];
  write ("ipSeedArray[2] %X",ipSeedArray[2]);
  u8_s_ChangeBitList_FixByte_Seed_19_1A[6] = ipSeedArray[1];
  write ("ipSeedArray[1] %X",ipSeedArray[1]);
  u8_s_ChangeBitList_FixByte_Seed_19_1A[7] = ipSeedArray[0];
  write ("ipSeedArray[0] %X",ipSeedArray[0]);

  
  for(j= 8;j>0;j--){
    
    for(i =0;i<8;i++){
      
      
      u32_s_PositionB = ((u32_s_PositionA &0x01)^ ((u8_s_ChangeBitList_FixByte_Seed_19_1A[j-1]>>i)&0x01));
      u32_s_PositionB = (u32_s_PositionB<<23)&0x800000;
      u32_s_PositionB = ((u32_s_PositionA>>1) & 0xffffff) + u32_s_PositionB ;
      u32_s_PositionC = u32_s_PositionB;
      u32_s_PositionC21 = ((u32_s_PositionB>>23)&0x1)^ ((u32_s_PositionB>>20)&0x1);
      u32_s_PositionC16 = ((u32_s_PositionB>>23)&0x1)^ ((u32_s_PositionB>>15)&0x1);
      u32_s_PositionC13 = ((u32_s_PositionB>>23)&0x1)^ ((u32_s_PositionB>>12)&0x1);
      u32_s_PositionC6 = ((u32_s_PositionB>>23)&0x1)^ ((u32_s_PositionB>>5)&0x1);
      u32_s_PositionC4 = ((u32_s_PositionB>>23)&0x1)^ ((u32_s_PositionB>>3)&0x1);
      
      if((u32_s_PositionB>>20)&0x1){
        u32_s_PositionC = u32_s_PositionC &((u32_s_PositionC21<<20)|0xEFFFFF);
        
      }else{
        u32_s_PositionC = u32_s_PositionC |((u32_s_PositionC21<<20));
      }
      if((u32_s_PositionB>>15)&0x1){
        u32_s_PositionC = u32_s_PositionC &((u32_s_PositionC16<<15)|0xFF7FFF);
      }else{
        u32_s_PositionC = u32_s_PositionC |((u32_s_PositionC16<<15));
      }
      if((u32_s_PositionB>>12)&0x1){
        u32_s_PositionC = u32_s_PositionC &((u32_s_PositionC13<<12)|0xFFEFFF);
      }else{
        u32_s_PositionC = u32_s_PositionC |((u32_s_PositionC13<<12));
      }
      if((u32_s_PositionB>>5)&0x1){
        u32_s_PositionC = u32_s_PositionC &((u32_s_PositionC6<<5)|0xFFFFDF);
      }else{
        u32_s_PositionC = u32_s_PositionC |((u32_s_PositionC6<<5));
      }
      if((u32_s_PositionB>>3)&0x1){
        u32_s_PositionC = u32_s_PositionC &((u32_s_PositionC4<<3)|0xFFFFF7);
      }else{
        u32_s_PositionC = u32_s_PositionC |((u32_s_PositionC4<<3));
      }
      u32_s_PositionA = u32_s_PositionC;
      
    }
  }
 
  iopKeyArray[0] = (byte)((u32_s_PositionC >> 4)&0xff);
  iopKeyArray[1] = ((byte)(u32_s_PositionC >> 8) & 0xF0) | (byte)(u32_s_PositionC >> 20);
  iopKeyArray[2] = ((((byte)u32_s_PositionC) << 4) | ((byte)(u32_s_PositionC >> 16) & 0x0F));
	
  
  DiagMsgSecLv19_1A[2] = iopKeyArray[0];
  DiagMsgSecLv19_1A[3] = iopKeyArray[1];
  DiagMsgSecLv19_1A[4] = iopKeyArray[2];
//  
//  @Test::Key_Array_3_Bytes[0] = iopKeyArray[0];
//  @Test::Key_Array_3_Bytes[1] = iopKeyArray[1];
//  @Test::Key_Array_3_Bytes[2] = iopKeyArray[2];
  
  write ("iopKeyArray %x %x %x", iopKeyArray[0], iopKeyArray[1], iopKeyArray[2]);
  write ("DiagMsgSecLv1_2 %x %x %x", DiagMsgSecLv19_1A[2], DiagMsgSecLv19_1A[3], DiagMsgSecLv19_1A[4]);
  testStep("Security","Send 27 1A");
  if(Unlock_191A == 1)
  {
      testStepPass("Security","Send 27 1A true key completely");
      setTimer(tmr_19_1A,50);
  }
  else
  {
    testStepPass("Security","Send 27 1A wrong key completely");
    DiagMsgSecLv19_1A[4] = 0;
    setTimer(tmr_19_1A,50);
  }
  
}

on timer tmr_01_02
{
   Send_Diagnostic_Msg(0xE80,0x1fff,DiagMsgSecLv1_2,5+4);
}

on timer tmr_05_06
{
   	Send_Diagnostic_Msg(0xE80,0x1015,DiagMsgSecLv5_6,5+4);

}

on timer tmr_19_1A
{
   	Send_Diagnostic_Msg(0xE80,0x1015,DiagMsgSecLv19_1A,5+4);

}