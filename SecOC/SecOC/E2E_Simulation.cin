/*@!Encoding:936*/

  variables
{
    byte Crc_Table8H1D[256] = {
    //00 //01 //02 //03 //04 //05 //06 //07 //08 //09 //0A //0B //0C //0D //0E //0F 
    0x00,0x1d,0x3A,0x27,0x74,0x69,0x4e,0x53,0xe8,0xf5,0xd2,0xcf,0x9c,0x81,0xa6,0xbb, //00
    0xCD,0xD0,0xF7,0xEA,0xB9,0xA4,0x83,0x9e,0x25,0x38,0x1F,0x02,0x51,0x4C,0x6B,0x76, //01
    0x87,0x9A,0xBD,0xA0,0xF3,0xEE,0xC9,0xD4,0x6F,0x72,0x55,0x48,0x1B,0x06,0x21,0x3C, //02
    0x4A,0x57,0x70,0x6D,0x3E,0x23,0x04,0x19,0xA2,0xBF,0x98,0x85,0xD6,0xCB,0xEC,0xF1, //03
    0x13,0x0E,0x29,0x34,0x67,0x7A,0x5D,0x40,0xFB,0xE6,0xC1,0xDC,0x8F,0x92,0xB5,0xA8, //04
    0xDE,0xC3,0xE4,0xF9,0xAA,0xB7,0x90,0x8D,0x36,0x2B,0x0C,0x11,0x42,0x5F,0x78,0x65, //05
    0x94,0x89,0xAE,0xB3,0xE0,0xFD,0xDA,0xC7,0x7C,0x61,0x46,0x5B,0x08,0x15,0x32,0x2F, //06
    0x59,0x44,0x63,0x7E,0x2D,0x30,0x17,0x0A,0xB1,0xAC,0x8B,0x96,0xC5,0xD8,0xFF,0xE2, //07
    0x26,0x3B,0x1C,0x01,0x52,0x4F,0x68,0x75,0xCE,0xD3,0xF4,0xE9,0xBA,0xA7,0x80,0x9D, //08
    0xEB,0xF6,0xD1,0xCC,0x9F,0x82,0xA5,0xB8,0x03,0x1E,0x39,0x24,0x77,0x6A,0x4D,0x50, //09
    0xA1,0xBC,0x9B,0x86,0xD5,0xC8,0xEF,0xF2,0x49,0x54,0x73,0x6E,0x3D,0x20,0x07,0x1A, //0A
    0x6C,0x71,0x56,0x4B,0x18,0x05,0x22,0x3F,0x84,0x99,0xBE,0xA3,0xF0,0xED,0xCA,0xD7, //0B
    0x35,0x28,0x0F,0x12,0x41,0x5C,0x7B,0x66,0xDD,0xC0,0xE7,0xFA,0xA9,0xB4,0x93,0x8E, //0C
    0xF8,0xE5,0xC2,0xDF,0x8C,0x91,0xB6,0xAB,0x10,0x0D,0x2A,0x37,0x64,0x79,0x5E,0x43, //0D
    0xB2,0xAF,0x88,0x95,0xC6,0xDB,0xFC,0xE1,0x5A,0x47,0x60,0x7D,0x2E,0x33,0x14,0x09, //0E
    0x7F,0x62,0x45,0x58,0x0B,0x16,0x31,0x2C,0x97,0x8A,0xAD,0xB0,0xE3,0xFE,0xD9,0xC4  //0F 
  };
  /* -------- SM4 常量 -------- */
  
  byte SM4_SBOX[256] = {
    0xD6,0x90,0xE9,0xFE,0xCC,0xE1,0x3D,0xB7,0x16,0xB6,0x14,0xC2,0x28,0xFB,0x2C,0x05,
    0x2B,0x67,0x9A,0x76,0x2A,0xBE,0x04,0xC3,0xAA,0x44,0x13,0x26,0x49,0x86,0x06,0x99,
    0x9C,0x42,0x50,0xF4,0x91,0xEF,0x98,0x7A,0x33,0x54,0x0B,0x43,0xED,0xCF,0xAC,0x62,
    0xE4,0xB3,0x1C,0xA9,0xC9,0x08,0xE8,0x95,0x80,0xDF,0x94,0xFA,0x75,0x8F,0x3F,0xA6,
    0x47,0x07,0xA7,0xFC,0xF3,0x73,0x17,0xBA,0x83,0x59,0x3C,0x19,0xE6,0x85,0x4F,0xA8,
    0x68,0x6B,0x81,0xB2,0x71,0x64,0xDA,0x8B,0xF8,0xEB,0x0F,0x4B,0x70,0x56,0x9D,0x35,
    0x1E,0x24,0x0E,0x5E,0x63,0x58,0xD1,0xA2,0x25,0x22,0x7C,0x3B,0x01,0x21,0x78,0x87,
    0xD4,0x00,0x46,0x57,0x9F,0xD3,0x27,0x52,0x4C,0x36,0x02,0xE7,0xA0,0xC4,0xC8,0x9E,
    0xEA,0xBF,0x8A,0xD2,0x40,0xC7,0x38,0xB5,0xA3,0xF7,0xF2,0xCE,0xF9,0x61,0x15,0xA1,
    0xE0,0xAE,0x5D,0xA4,0x9B,0x34,0x1A,0x55,0xAD,0x93,0x32,0x30,0xF5,0x8C,0xB1,0xE3,
    0x1D,0xF6,0xE2,0x2E,0x82,0x66,0xCA,0x60,0xC0,0x29,0x23,0xAB,0x0D,0x53,0x4E,0x6F,
    0xD5,0xDB,0x37,0x45,0xDE,0xFD,0x8E,0x2F,0x03,0xFF,0x6A,0x72,0x6D,0x6C,0x5B,0x51,
    0x8D,0x1B,0xAF,0x92,0xBB,0xDD,0xBC,0x7F,0x11,0xD9,0x5C,0x41,0x1F,0x10,0x5A,0xD8,
    0x0A,0xC1,0x31,0x88,0xA5,0xCD,0x7B,0xBD,0x2D,0x74,0xD0,0x12,0xB8,0xE5,0xB4,0xB0,
    0x89,0x69,0x97,0x4A,0x0C,0x96,0x77,0x7E,0x65,0xB9,0xF1,0x09,0xC5,0x6E,0xC6,0x84,
    0x18,0xF0,0x7D,0xEC,0x3A,0xDC,0x4D,0x20,0x79,0xEE,0x5F,0x3E,0xD7,0xCB,0x39,0x48
  };
  
  dword SM4_FK[4] = { 0xA3B1BAC6, 0x56AA3350, 0x677D9197, 0xB27022DC };
  
  dword SM4_CK[32] = {
    0x00070E15,0x1C232A31,0x383F464D,0x545B6269,0x70777E85,0x8C939AA1,0xA8AFB6BD,0xC4CBD2D9,
    0xE0E7EEF5,0xFC030A11,0x181F262D,0x343B4249,0x50575E65,0x6C737A81,0x888F969D,0xA4ABB2B9,
    0xC0C7CED5,0xDCE3EAF1,0xF8FF060D,0x141B2229,0x30373E45,0x4C535A61,0x686F767D,0x848B9299,
    0xA0A7AEB5,0xBCC3CAD1,0xD8DFE6ED,0xF4FB0209,0x10171E25,0x2C333A41,0x484F565D,0x646B7279
  };

  byte DataID[2]  = {0x00, 0x00};
  
  //byte keytest[16] = {0x01,0x02,0x03,0x04,0x05,0x06,0x07,0x08,0x09,0x0A,0x0B,0x0C,0x0D,0x0E,0x0F,0x10};
  byte keytest[16] = {0x45,0xA3,0xD7,0x86,0x30,0x38,0x97,0x1B,0x77,0xDB,0x79,0x97,0x2C,0xAD,0x76,0xDE};
  dword key_length = 16;

  struct PduState{
    dword pduID[56];
    byte E2Econfigured[56];
    byte SecOCconfigured[56];
    byte E2E_Counter[56];
    dword prevTripCnt[56];
    word prevResetCnt[56];
    dword msgCnt[56];    
  };
  int RxPDUCount = 56;// 结构体个数
  struct PduState RxPDU ={
    {0x382,0x377,0x390,0x36A,0x150,0x32B,0x305,0x319,0x32A,0x3CE,
     //0,   1,     2,    3,    4,    5,    6,    7,    8,    9, 
     0x385,0x1E2,0x38B,0x1F1,0x170,0x12B,0x28C,0x289,0x72505,0x72506,
     //10,   11,   12,   13,   14,   15,   16,   17,   18,    19, 
     0x31003,0x72514,0x1AE,0x72507,0x72509,0x72510,0x1A7,0x156,0x149,0x1A9,
     //20,    21,     22,    23,    24,     25,     26,    27,    28,   29, 
     0x153,0x1FB,0x1F6,0x9D,0x222,0xC9,0x8F,0x3E0,0x12358,0x123,
     //30,   31,   32,   33,   34,  35,  36,  37,    38,    39, 
     0x309,0x960105,0xE1,0xF7,0x96010,0x96002,0x163,0x187,0x18C,0x12A,
     //40,   41,     42,  43,    44,    45,    46,    47,    48,    49, 
     0xB3,0x9F,0x7D,0x24F,0x56F,0x100000F7
     //50, 51,  52,  53,   54,    5,    6,    7,    8,    9, 
    //100000F7特殊id，用于CHCANFD的F7报文，带SecOC,0xF7用于PTCANFD的F7，不带SecOC
    },//pduID
    {1,1,1,1,1,1,1,1,1,1,1,1,1,1,1,1,1,1,1,1,1,1,1,1,1,1,1,1,1,1,1,1,1,1,1,1,1,1,1,1,1,1,1,1,1,1,1,1,1,0,0,0,0,0,0,1},//E2E configured
    {0,0,0,0,0,0,0,0,0,0,0,0,0,0,0,0,0,0,0,0,0,0,0,0,0,0,0,0,0,0,0,0,0,0,1,0,0,0,0,0,0,0,1,0,0,0,0,0,0,1,1,1,1,1,1,1},//SecOC configured
    {0xE,0xE,0xE,0xE,0xE,0xE,0xE,0xE,0xE,0xE,0xE,0xE,0xE,0xE,0xE,0xE,0xE,0xE,0xE,0xE,0xE,0xE,0xE,0xE,0xE,0xE,0xE,0xE,0xE,0xE,0xE,0xE,0xE,0xE,0xE,0xE,0xE,0xE,0xE,0xE,0xE,0xE,0xE,0xE,0xE,0xE,0xE,0xE,0xE,0xE,0xE,0xE,0xE,0xE,0xE,0xE},//E2E counter initial
    {0,0,0,0,0,0,0,0,0,0,0,0,0,0,0,0,0,0,0,0,0,0,0,0,0,0,0,0,0,0,0,0,0,0,0,0,0,0,0,0,0,0,0,0,0,0,0,0,0,0,0,0,0,0,0,0},//prevTripCnt
    {0,0,0,0,0,0,0,0,0,0,0,0,0,0,0,0,0,0,0,0,0,0,0,0,0,0,0,0,0,0,0,0,0,0,0,0,0,0,0,0,0,0,0,0,0,0,0,0,0,0,0,0,0,0,0,0},//prevResetCnt
    {0,0,0,0,0,0,0,0,0,0,0,0,0,0,0,0,0,0,0,0,0,0,0,0,0,0,0,0,0,0,0,0,0,0,0,0,0,0,0,0,0,0,0,0,0,0,0,0,0,0,0,0,0,0,0,0}//msgCnt
    // 0: PDU FDR_100ms_PDU01
    // 1: PDU IAM_100ms_PDU08
    // 2: PDU IAM_ZONE_100ms_PDU34
    // 3: PDU IAM_ZONE_100ms_PDU40
    // 4: PDU IAM_20ms_PDU32
    // 5: PDU IAM_100ms_PDU18
    // 6: PDU IAM_ZONE_100ms_PDU13
    // 7: PDU IAM_ZONE_100ms_PDU35
    // 8: PDU IAM_ZONE_100ms_PDU57
    // 9: PDU IAM_ZONE_100ms_PDU56
    // 10: PDU ICBVC_100ms_PDU78
    // 11: PDU ICBVC_50ms_PDU11
    // 12: PDU ICBVC_100ms_PDU80
    // 13: PDU ICBVC_20ms_PDU03
    // 14: PDU ICBVC_30ms_PDU158
    // 15: PDU LHZCU_20ms_PDU03
    // 16: PDU LHZCU_50ms_PDU06
    // 17: PDU RHZCU_50ms_PDU01
    // 18: PDU EPS_10ms_PDU01 0x1AD CHCAN
    // 19: PDU EPS_10ms_PDU02 0x1AD CHCAN
    // 20: PDU EPS_010ms_PDU03 0x1AD CHCAN
    // 21: PDU EPS_10ms_PDU05 0xAD CHCAN
    // 22: PDU EPS_20ms_PDU03
    // 23: PDU IBS_10ms_PDU04 0xB8 CHCAN
    // 24: PDU IBS_20ms_PDU10 0x18A CHCAN
    // 25: PDU IBS_20ms_PDU13 0x18A CHCAN
    // 26: PDU IBS_20ms_PDU07
    // 27: PDU IBS_20ms_PDU08
    // 28: PDU IBS_20ms_PDU09
    // 29: PDU IBS_20ms_PDU11
    // 30: PDU IBS_20ms_PDU12
    // 31: PDU IBS_ZONE_20ms_PDU08
    // 32: PDU IMCU_20ms_PDU58
    // 33: PDU LHZCU_10ms_PDU01
    // 34: PDU LHZCU_50ms_PDU07
    // 35: PDU RZCU_10ms_PDU24
    // 36: PDU RZCU_10ms_PDU64
    // 37: PDU CCU_100ms_PDU07
    // 38: PDU ESS_100ms_PDU58 0x301 PTCAN
    // 39: PDU ICBVC_20ms_PDU05
    // 40: PDU RZCU_100ms_PDU10
    // 41: PDU RZCU_20ms_PDU06 0x194 PTCAN
    // 42: PDU RZCU_10ms_PDU23
    // 43: PDU RZCU_10ms_PDU22
    // 44: PDU RZCU_10ms_PDU02 0xB4 SFCAN
    // 45: PDU RZCU_10ms_PDU01 0xB4 SFCAN
    // 46: PDU SDM_20ms_PDU01
    // 47: PDU SDM_20ms_PDU02
    // 48: PDU SDM_20ms_PDU03    
    // 49: PDU IAM_ZONE_20ms_PDU10
    // 50: PDU IAM_ZONE_Sporadic_PDU01
    // 51: PDU IAM_ZONE_Sporadic_PDU02
    // 52: PDU IAM_ZONE_Sporadic_PDU03
    // 53: PDU ICBVC_50ms_PDU55
    // 54: PDU ICBVC_SecOC_SyncMsg

    
  };
  
}

byte CRC_crc8Table(byte data[], dword len, byte table[],byte startVal, byte xorVal)
{
  dword index = 0;
  byte  crc = 0;
  
  crc = startVal ^ xorVal;
  
  for (index = 0; index < len; index++)
  {
      crc = table[crc ^ data[index]];
  }

  crc ^= xorVal;
    
  return crc;
}


void memcpy_offset(byte dest[], byte src[], byte offset, dword len)
{
  int i = 0;
  
  for(i=offset; i<(len+offset); i++)
  {
     dest[i-offset] = src[i];
  }
}

int FindIndex(dword pduID)
{
  int i;
  for(i=0;i<RxPDUCount;i++)
  {
    if(RxPDU.pduID[i] == pduID)
    {return i;}
  }
  return -1;
}

void PreProcess_CRC_Offset(byte data[], dword aDlc, byte DID[], byte count, byte crc_offset)
{
  byte data_temp[64];
  byte crc = 0;
  //calculate E2E DataID CRC
  crc = CRC_crc8Table(DID, 2, Crc_Table8H1D, 0xFF, 0xFF);
  
  //update rolling counter
  data[crc_offset+1] = (data[crc_offset+1] & 0xF0) | count; // first is zero
  
  //calculate E2E Data ID CRC
  
  memcpy_offset(data_temp, data, crc_offset+1, aDlc-1);
  crc = CRC_crc8Table(data_temp, aDlc-1, Crc_Table8H1D, crc, 0xFF);
  
  data[crc_offset] = crc ^ 0xFF;
}
void PreProcess_calculateCount(byte deltacounter,byte index)
{
      RxPDU.E2E_Counter[index] = RxPDU.E2E_Counter[index] + deltacounter; 
      RxPDU.E2E_Counter[index] %= 0x0F;
//  write("%x",count[index]);
}


/* ==========================================
 *  CMAC over SM4 (CAPL 兼容版)
 *  关键点：
 *    - 不再使用 key/in/out 作为标识符
 *    - 形参数组使用不定长 []
 *    - 局部变量全部在函数顶部声明
 * ========================================== */

/* -------- 基础工具 -------- */

dword ROTL32(dword x, int n) {
  return ((x << n) | (x >> (32 - n)));
}

dword bytesToDwordBE(byte b[], int off) {
  dword v;
  v = 0;
  v |= ((dword)b[off]   & 0xFF) << 24;
  v |= ((dword)b[off+1] & 0xFF) << 16;
  v |= ((dword)b[off+2] & 0xFF) << 8;
  v |= ((dword)b[off+3] & 0xFF);
  return v;
}

void dwordToBytesBE(dword v, byte outBuf[], int off) {
  outBuf[off]   = (byte)((v >> 24) & 0xFF);
  outBuf[off+1] = (byte)((v >> 16) & 0xFF);
  outBuf[off+2] = (byte)((v >> 8)  & 0xFF);
  outBuf[off+3] = (byte)(v & 0xFF);
}

void xor16(byte a[], byte b[], byte outBuf[]) {
  int i;
  for (i = 0; i < 16; i++) {
    outBuf[i] = (byte)(a[i] ^ b[i]);
  }
}

/* 128-bit 左移 1 位 */
void leftShiftOneBit128(byte inBuf[], byte outBuf[]) {
  int i;
  byte carry;
  byte newCarry;
  carry = 0;
  for (i = 15; i >= 0; i--) {
    newCarry = ((inBuf[i] & 0x80) != 0) ? 1 : 0;
    outBuf[i] = (byte)((inBuf[i] << 1) & 0xFE);
    outBuf[i] = (byte)(outBuf[i] | carry);
    carry = newCarry;
  }
}


/* -------- SM4 变换 -------- */

dword sm4_tauSub(dword x) {
  byte b0;
  byte b1;
  byte b2;
  byte b3;
  dword r;

  b0 = (byte)((x >> 24) & 0xFF);
  b1 = (byte)((x >> 16) & 0xFF);
  b2 = (byte)((x >> 8)  & 0xFF);
  b3 = (byte)(x & 0xFF);

  b0 = SM4_SBOX[b0 & 0xFF];
  b1 = SM4_SBOX[b1 & 0xFF];
  b2 = SM4_SBOX[b2 & 0xFF];
  b3 = SM4_SBOX[b3 & 0xFF];

  r = ((dword)b0 << 24) | ((dword)b1 << 16) | ((dword)b2 << 8) | (dword)b3;
  return r;
}

/* L(B) = B ^ ROTL(B,2) ^ ROTL(B,10) ^ ROTL(B,18) ^ ROTL(B,24) */
dword sm4_L_enc(dword b) {
  return b ^ ROTL32(b, 2) ^ ROTL32(b, 10) ^ ROTL32(b, 18) ^ ROTL32(b, 24);
}

/* L'(B) = B ^ ROTL(B,13) ^ ROTL(B,23) */
dword sm4_L_key(dword b) {
  return b ^ ROTL32(b, 13) ^ ROTL32(b, 23);
}

dword sm4_T_enc(dword x) {
  return sm4_L_enc(sm4_tauSub(x));
}

dword sm4_T_key(dword x) {
  return sm4_L_key(sm4_tauSub(x));
}

/* -------- SM4 密钥扩展 & 单块加密 -------- */
/* 注意：这里的 k 是 16 字节的密钥 */
void sm4_setRk(byte k[], dword rk[]) {
  dword MK0, MK1, MK2, MK3;
  dword K0, K1, K2, K3;
  dword Ktmp0, Ktmp1, Ktmp2, Ktmp3;
  int i;
  dword t, Ki;

  MK0 = bytesToDwordBE(k, 0);
  MK1 = bytesToDwordBE(k, 4);
  MK2 = bytesToDwordBE(k, 8);
  MK3 = bytesToDwordBE(k, 12);

  K0 = MK0 ^ SM4_FK[0];
  K1 = MK1 ^ SM4_FK[1];
  K2 = MK2 ^ SM4_FK[2];
  K3 = MK3 ^ SM4_FK[3];

  Ktmp0 = K0; Ktmp1 = K1; Ktmp2 = K2; Ktmp3 = K3;

  for (i = 0; i < 32; i++) {
    t = Ktmp1 ^ Ktmp2 ^ Ktmp3 ^ SM4_CK[i];
    Ki = Ktmp0 ^ sm4_T_key(t);
    rk[i] = Ki;
    Ktmp0 = Ktmp1;
    Ktmp1 = Ktmp2;
    Ktmp2 = Ktmp3;
    Ktmp3 = Ki;
  }
}

void sm4_encryptBlock(byte inBlock[], byte outBlock[], dword rk[]) {
  dword X0, X1, X2, X3;
  dword x0, x1, x2, x3, t, x4;
  int i;

  X0 = bytesToDwordBE(inBlock, 0);
  X1 = bytesToDwordBE(inBlock, 4);
  X2 = bytesToDwordBE(inBlock, 8);
  X3 = bytesToDwordBE(inBlock, 12);

  x0 = X0; x1 = X1; x2 = X2; x3 = X3;

  for (i = 0; i < 32; i++) {
    t = x1 ^ x2 ^ x3 ^ rk[i];
    x4 = x0 ^ sm4_T_enc(t);
    x0 = x1;
    x1 = x2;
    x2 = x3;
    x3 = x4;
  }

  /* 输出为 (X35, X34, X33, X32) */
  dwordToBytesBE(x3, outBlock, 0);
  dwordToBytesBE(x2, outBlock, 4);
  dwordToBytesBE(x1, outBlock, 8);
  dwordToBytesBE(x0, outBlock, 12);
}

/* -------- CMAC(SM4) -------- */

/* 生成子密钥 K1, K2 (Rb=0x87) */
void cmac_sm4_generateSubkeys(byte k[], byte K1[], byte K2[]) {
  dword rk[32];
  byte Z[16];
  byte L[16];
  byte K1tmp[16];
  byte K2tmp[16];
  int i;

  for (i = 0; i < 16; i++) {
    Z[i] = 0x00;
  }

  sm4_setRk(k, rk);
  sm4_encryptBlock(Z, L, rk);

  leftShiftOneBit128(L, K1tmp);
  if ((L[0] & 0x80) != 0) {
    K1tmp[15] = (byte)(K1tmp[15] ^ 0x87);
  }
  for (i = 0; i < 16; i++) {
    K1[i] = K1tmp[i];
  }

  leftShiftOneBit128(K1, K2tmp);
  if ((K1[0] & 0x80) != 0) {
    K2tmp[15] = (byte)(K2tmp[15] ^ 0x87);
  }
  for (i = 0; i < 16; i++) {
    K2[i] = K2tmp[i];
  }
}

/* 计算 CMAC-SM4 */
void cmac_sm4(byte k[], byte msg[], int msgLen, byte mac[]) {
  dword rk[32];
  byte K1[16], K2[16];
  byte X[16];
  byte block[16];
  byte xored[16];
  byte last[16];
  byte xoredLast[16];
  int i, j;
  int n;
  int lastComplete;
  int rem;
  int idx;

  // ========================================================
  // FIX CHí M?NG: Kh?i t?o toàn b? m?ng local v? 0 
  // ?? ch?ng hi?n t??ng CAPL l?u tr?ng thái bi?n c?a l?n g?i tr??c
  // ========================================================
  for(i = 0; i < 32; i++) rk[i] = 0;
  for(i = 0; i < 16; i++) {
    K1[i] = 0; K2[i] = 0; X[i] = 0; 
    block[i] = 0; xored[i] = 0; last[i] = 0; xoredLast[i] = 0;
  }

  // B?t ??u tính toán thu?t toán
  sm4_setRk(k, rk);
  cmac_sm4_generateSubkeys(k, K1, K2);

  n = (msgLen + 15) / 16;
  lastComplete = (msgLen > 0) && ((msgLen % 16) == 0);
  if (n == 0) {
    n = 1;
    lastComplete = 0;
  }

  /* Tính cho (n-1) block ??u tiên */
  for (i = 0; i < n - 1; i++) {
    for (j = 0; j < 16; j++) {
      idx = i * 16 + j;
      if (idx < msgLen) {
        block[j] = msg[idx];
      } else {
        block[j] = 0x00;
      }
    }
    xor16(X, block, xored);
    sm4_encryptBlock(xored, X, rk);
  }

  /* X? ly block cu?i cùng */
  if (lastComplete) {
    for (j = 0; j < 16; j++) {
      last[j] = msg[(n - 1) * 16 + j];
    }
    for (j = 0; j < 16; j++) {
      last[j] = (byte)(last[j] ^ K1[j]);
    }
  } else {
    rem = msgLen - ((n - 1) * 16);
    // ?o?n gán last[j] = 0x00 ?? ???c cover b?i hàm clear ? trên cùng
    for (j = 0; j < rem; j++) {
      last[j] = msg[(n - 1) * 16 + j];
    }
    last[rem] = (byte)0x80; /* Padding bit */
    for (j = 0; j < 16; j++) {
      last[j] = (byte)(last[j] ^ K2[j]);
    }
  }

  /* T = E_k(X ^ last) */
  xor16(X, last, xoredLast);
  sm4_encryptBlock(xoredLast, mac, rk);
}

void Preprocess_SecOC(dword pduID, int index,dword aPayloadLength, byte data[])
{
//  byte keytest[16] = {0x01,0x02,0x03,0x04,0x05,0x06,0x07,0x08,0x09,0x0A,0x0B,0x0C,0x0D,0x0E,0x0F,0x10};
//  dword key_length = 16;
  byte MAC_in[64]={0x00,0x00,0x00,0x00,0x00,0x00,0x00,0x00,
                    0x00,0x00,0x00,0x00,0x00,0x00,0x00,0x00,
                    0x00,0x00,0x00,0x00,0x00,0x00,0x00,0x00,
                    0x00,0x00,0x00,0x00,0x00,0x00,0x00,0x00,
                    0x00,0x00,0x00,0x00,0x00,0x00,0x00,0x00,
                    0x00,0x00,0x00,0x00,0x00,0x00,0x00,0x00,
                    0x00,0x00,0x00,0x00,0x00,0x00,0x00,0x00,
                    0x00,0x00,0x00,0x00,0x00,0x00,0x00,0x00};
  dword MAC_in_length;
  byte MAC_out[16];
  dword MAC_outLength = 16;
  dword Trip_Value;
  dword Reset_Value;
  qword freshnesstemp;
  dword freshnesslength;
  byte freshnessID[2] = {0x00,0x00};
  byte freshnessVal[8]= {0x00,0x00,0x00,0x00,0x00,0x00,0x00,0x00};
  byte resetflag;
  int i,p;
  
  p=0;
  freshnessID[0] = (pduID>>8) & 0xFF;
  freshnessID[1] = (pduID) & 0xFF;
  
  if((RxPDU.prevTripCnt[index]==@sysvar::Security::TripCounter)&&(RxPDU.prevResetCnt[index]==@sysvar::Security::ResetCounter))
  {
    Trip_Value = RxPDU.prevTripCnt[index];
    Reset_Value = RxPDU.prevResetCnt[index];
    if(RxPDU.msgCnt[index]<=((2<<22)-1)){RxPDU.msgCnt[index]++;}
    else{RxPDU.msgCnt[index]=(2<<22)-1;}   
  }
  else
  {
    Trip_Value = @sysvar::Security::TripCounter;
    Reset_Value = @sysvar::Security::ResetCounter;
    RxPDU.msgCnt[index]=1; 
    RxPDU.prevTripCnt[index]=@sysvar::Security::TripCounter;
    RxPDU.prevResetCnt[index]=@sysvar::Security::ResetCounter;
  }

  resetflag = (Reset_Value)&0x3;
  freshnesslength = 64;
  
  freshnessVal[0]=(Trip_Value >> 16)&0xFF;
  freshnessVal[1]=(Trip_Value >> 8)&0xFF;
  freshnessVal[2]=(Trip_Value)&0xFF;
  freshnessVal[3]=(Reset_Value >> 8)&0xFF;
  freshnessVal[4]=(Reset_Value)&0xFF;
  freshnessVal[5]=((RxPDU.msgCnt[index]<<2) >> 16)&0xFF;
  freshnessVal[6]=((RxPDU.msgCnt[index]<<2) >> 8)&0xFF;
  freshnessVal[7]=((RxPDU.msgCnt[index]<<2)|resetflag )&0xFF;
  MAC_in[p++] = freshnessID[0];
  MAC_in[p++] = freshnessID[1];
  for(i=0;i<aPayloadLength-4;i++)
  {
    MAC_in[p++] = data[i];
  }
  for(i=0;i<freshnesslength/8;i++)
  {
    MAC_in[p++] = freshnessVal[i];
  }
  MAC_in_length = p;

  cmac_sm4(keytest,MAC_in,MAC_in_length,MAC_out);
  data[aPayloadLength-4]=freshnessVal[7];
  data[aPayloadLength-3]=MAC_out[0];
  data[aPayloadLength-2]=MAC_out[1];
  data[aPayloadLength-1]=MAC_out[2];
}


void PreProcess_PDU(dword pduID, dword aPayloadLength, byte data[], byte deltacounter, byte CRCerror, byte SecOCerror)
{
  int index;
  index = FindIndex(pduID);
  if(RxPDU.E2Econfigured[index]==1)
  {
    PreProcess_calculateCount(deltacounter,index);
    PreProcess_CRC_Offset(data, aPayloadLength, DataID, RxPDU.E2E_Counter[index], 0); 
    if(CRCerror){data[0]=0xFF;}    
  }
  if(RxPDU.SecOCconfigured[index]==1)
  {
    Preprocess_SecOC(pduID, index, aPayloadLength, data);
    if(SecOCerror==1)
    {
      data[aPayloadLength-4]=0xFF;
      data[aPayloadLength-3]=0xFF;
      data[aPayloadLength-2]=0xFF;
      data[aPayloadLength-1]=0xFF;     
    }
  }
}
//
//dword applPDUILTxPending (dword busContext, dword longID, dword shortID, char name[], dword & aPayloadLength, byte data[])
//{
//  int i;
////busContext = 0x00010001,longID = 0xFFFFFFFE;shortID = pdu ID;
////write("PDU name=%s shortID=%x longID=%x", name, shortID, longID);
//  switch(shortID)
//  {
//                //dword pduID, dword aPayloadLength, byte data[], byte deltacounter, byte CRCerror, byte SecOCerror
//    case 0x1A7:  PreProcess_PDU(shortID, aPayloadLength, data, @Msg_Error::IBS_20ms_PDU07.rolling_counter_delta, @Msg_Error::IBS_20ms_PDU07.checksum_error, @Msg_Error::IBS_20ms_PDU07.secoc_error);break; //IBS_20ms_PDU07
//    case 0x156:  PreProcess_PDU(shortID, aPayloadLength, data, @Msg_Error::IBS_20ms_PDU08.rolling_counter_delta, @Msg_Error::IBS_20ms_PDU08.checksum_error, @Msg_Error::IBS_20ms_PDU08.secoc_error);break; //IBS_20ms_PDU08
//    case 0x149:  PreProcess_PDU(shortID, aPayloadLength, data, @Msg_Error::IBS_20ms_PDU09.rolling_counter_delta, @Msg_Error::IBS_20ms_PDU09.checksum_error, @Msg_Error::IBS_20ms_PDU09.secoc_error);break; //IBS_20ms_PDU09
//    case 0x1A9:  PreProcess_PDU(shortID, aPayloadLength, data, @Msg_Error::IBS_20ms_PDU11.rolling_counter_delta, @Msg_Error::IBS_20ms_PDU11.checksum_error, @Msg_Error::IBS_20ms_PDU11.secoc_error);break; //IBS_20ms_PDU11
//    case 0x153:  PreProcess_PDU(shortID, aPayloadLength, data, @Msg_Error::IBS_20ms_PDU12.rolling_counter_delta, @Msg_Error::IBS_20ms_PDU12.checksum_error, @Msg_Error::IBS_20ms_PDU12.secoc_error);break; //IBS_20ms_PDU12
//    case 0x1FB:  PreProcess_PDU(shortID, aPayloadLength, data, @Msg_Error::IBS_ZONE_20ms_PDU08.rolling_counter_delta, @Msg_Error::IBS_ZONE_20ms_PDU08.checksum_error, @Msg_Error::IBS_ZONE_20ms_PDU08.secoc_error);break; //IBS_ZONE_20ms_PDU08
//    case 0x12B:  PreProcess_PDU(shortID, aPayloadLength, data, @Msg_Error::LHZCU_20ms_PDU03.rolling_counter_delta, @Msg_Error::LHZCU_20ms_PDU03.checksum_error, @Msg_Error::LHZCU_20ms_PDU03.secoc_error);break; //LHZCU_20ms_PDU03
//    case 0x163:  PreProcess_PDU(shortID, aPayloadLength, data, @Msg_Error::SDM_20ms_PDU01.rolling_counter_delta, @Msg_Error::SDM_20ms_PDU01.checksum_error, @Msg_Error::SDM_20ms_PDU01.secoc_error);break; //SDM_20ms_PDU01
//    case 0x187:  PreProcess_PDU(shortID, aPayloadLength, data, @Msg_Error::SDM_20ms_PDU02.rolling_counter_delta, @Msg_Error::SDM_20ms_PDU02.checksum_error, @Msg_Error::SDM_20ms_PDU02.secoc_error);break; //SDM_20ms_PDU02
//    case 0x28C:  PreProcess_PDU(shortID, aPayloadLength, data, @Msg_Error::LHZCU_50ms_PDU06.rolling_counter_delta, @Msg_Error::LHZCU_50ms_PDU06.checksum_error, @Msg_Error::LHZCU_50ms_PDU06.secoc_error);break; //LHZCU_50ms_PDU06
//    case 0x289:  PreProcess_PDU(shortID, aPayloadLength, data, @Msg_Error::RHZCU_50ms_PDU01.rolling_counter_delta, @Msg_Error::RHZCU_50ms_PDU01.checksum_error, @Msg_Error::RHZCU_50ms_PDU01.secoc_error);break; //RHZCU_50ms_PDU01
//    case 0x377:  PreProcess_PDU(shortID, aPayloadLength, data, @Msg_Error::IAM_100ms_PDU08.rolling_counter_delta, @Msg_Error::IAM_100ms_PDU08.checksum_error, @Msg_Error::IAM_100ms_PDU08.secoc_error);break; //IAM_100ms_PDU08
//    case 0x305:  PreProcess_PDU(shortID, aPayloadLength, data, @Msg_Error::IAM_ZONE_100ms_PDU13.rolling_counter_delta, @Msg_Error::IAM_ZONE_100ms_PDU13.checksum_error, @Msg_Error::IAM_ZONE_100ms_PDU13.secoc_error);break; //IAM_ZONE_100ms_PDU13
//    case 0x390:  PreProcess_PDU(shortID, aPayloadLength, data, @Msg_Error::IAM_ZONE_100ms_PDU34.rolling_counter_delta, @Msg_Error::IAM_ZONE_100ms_PDU34.checksum_error, @Msg_Error::IAM_ZONE_100ms_PDU34.secoc_error);break; //IAM_ZONE_100ms_PDU34
//    case 0x319:  PreProcess_PDU(shortID, aPayloadLength, data, @Msg_Error::IAM_ZONE_100ms_PDU35.rolling_counter_delta, @Msg_Error::IAM_ZONE_100ms_PDU35.checksum_error, @Msg_Error::IAM_ZONE_100ms_PDU35.secoc_error);break; //IAM_ZONE_100ms_PDU35
//    case 0x36A:  PreProcess_PDU(shortID, aPayloadLength, data, @Msg_Error::IAM_ZONE_100ms_PDU40.rolling_counter_delta, @Msg_Error::IAM_ZONE_100ms_PDU40.checksum_error, @Msg_Error::IAM_ZONE_100ms_PDU40.secoc_error);break; //IAM_ZONE_100ms_PDU40
//    case 0x32A:  PreProcess_PDU(shortID, aPayloadLength, data, @Msg_Error::IAM_ZONE_100ms_PDU57.rolling_counter_delta, @Msg_Error::IAM_ZONE_100ms_PDU57.checksum_error, @Msg_Error::IAM_ZONE_100ms_PDU57.secoc_error);break; //IAM_ZONE_100ms_PDU57
//    case 0xE1:  PreProcess_PDU(shortID, aPayloadLength, data, @Msg_Error::RZCU_10ms_PDU23.rolling_counter_delta, @Msg_Error::RZCU_10ms_PDU23.checksum_error, @Msg_Error::RZCU_10ms_PDU23.secoc_error);break; //RZCU_10ms_PDU23
//    case 0x9D:  PreProcess_PDU(shortID, aPayloadLength, data, @Msg_Error::LHZCU_10ms_PDU01.rolling_counter_delta, @Msg_Error::LHZCU_10ms_PDU01.checksum_error, @Msg_Error::LHZCU_10ms_PDU01.secoc_error);break; //LHZCU_10ms_PDU01
//    case 0xF7:  
//      if(busContext == 0x10004){PreProcess_PDU(shortID, aPayloadLength, data, @Msg_Error::RZCU_10ms_PDU22_PT.rolling_counter_delta, @Msg_Error::RZCU_10ms_PDU22_PT.checksum_error, @Msg_Error::RZCU_10ms_PDU22_PT.secoc_error);break;} //RZCU_10ms_PDU22 PTCAN
//      else{PreProcess_PDU(0x100000F7, aPayloadLength, data, @Msg_Error::RZCU_10ms_PDU22_CH.rolling_counter_delta, @Msg_Error::RZCU_10ms_PDU22_CH.checksum_error, @Msg_Error::RZCU_10ms_PDU22_CH.secoc_error);break;} //RZCU_10ms_PDU22 CHCAN
//    case 0xC9:  PreProcess_PDU(shortID, aPayloadLength, data, @Msg_Error::RZCU_10ms_PDU24.rolling_counter_delta, @Msg_Error::RZCU_10ms_PDU24.checksum_error, @Msg_Error::RZCU_10ms_PDU24.secoc_error);break; //RZCU_10ms_PDU24
//    case 0x8F:  PreProcess_PDU(shortID, aPayloadLength, data, @Msg_Error::RZCU_10ms_PDU64.rolling_counter_delta, @Msg_Error::RZCU_10ms_PDU64.checksum_error, @Msg_Error::RZCU_10ms_PDU64.secoc_error);break; //RZCU_10ms_PDU64
//    case 0x1AE:  PreProcess_PDU(shortID, aPayloadLength, data, @Msg_Error::EPS_20ms_PDU03.rolling_counter_delta, @Msg_Error::EPS_20ms_PDU03.checksum_error, @Msg_Error::EPS_20ms_PDU03.secoc_error);break; //EPS_20ms_PDU03
//    case 0x150:  PreProcess_PDU(shortID, aPayloadLength, data, @Msg_Error::IAM_20ms_PDU32.rolling_counter_delta, @Msg_Error::IAM_20ms_PDU32.checksum_error, @Msg_Error::IAM_20ms_PDU32.secoc_error);break; //IAM_20ms_PDU32
//    case 0x1F1:  PreProcess_PDU(shortID, aPayloadLength, data, @Msg_Error::ICBVC_20ms_PDU03.rolling_counter_delta, @Msg_Error::ICBVC_20ms_PDU03.checksum_error, @Msg_Error::ICBVC_20ms_PDU03.secoc_error);break; //ICBVC_20ms_PDU03
//    case 0x123:  PreProcess_PDU(shortID, aPayloadLength, data, @Msg_Error::ICBVC_20ms_PDU05.rolling_counter_delta, @Msg_Error::ICBVC_20ms_PDU05.checksum_error, @Msg_Error::ICBVC_20ms_PDU05.secoc_error);break; //ICBVC_20ms_PDU05
//    case 0x1F6:  PreProcess_PDU(shortID, aPayloadLength, data, @Msg_Error::IMCU_20ms_PDU58.rolling_counter_delta, @Msg_Error::IMCU_20ms_PDU58.checksum_error, @Msg_Error::IMCU_20ms_PDU58.secoc_error);break; //IMCU_20ms_PDU58
//    case 0x18C:  PreProcess_PDU(shortID, aPayloadLength, data, @Msg_Error::SDM_20ms_PDU03.rolling_counter_delta, @Msg_Error::SDM_20ms_PDU03.checksum_error, @Msg_Error::SDM_20ms_PDU03.secoc_error);break; //SDM_20ms_PDU03
//    case 0x170:  PreProcess_PDU(shortID, aPayloadLength, data, @Msg_Error::ICBVC_30ms_PDU158.rolling_counter_delta, @Msg_Error::ICBVC_30ms_PDU158.checksum_error, @Msg_Error::ICBVC_30ms_PDU158.secoc_error);break; //ICBVC_30ms_PDU158
//    case 0x1E2:  PreProcess_PDU(shortID, aPayloadLength, data, @Msg_Error::ICBVC_50ms_PDU11.rolling_counter_delta, @Msg_Error::ICBVC_50ms_PDU11.checksum_error, @Msg_Error::ICBVC_50ms_PDU11.secoc_error);break; //ICBVC_50ms_PDU11
//    case 0x222:  PreProcess_PDU(shortID, aPayloadLength, data, @Msg_Error::LHZCU_50ms_PDU07.rolling_counter_delta, @Msg_Error::LHZCU_50ms_PDU07.checksum_error, @Msg_Error::LHZCU_50ms_PDU07.secoc_error);break; //LHZCU_50ms_PDU07
//    case 0x3E0:  PreProcess_PDU(shortID, aPayloadLength, data, @Msg_Error::CCU_100ms_PDU07.rolling_counter_delta, @Msg_Error::CCU_100ms_PDU07.checksum_error, @Msg_Error::CCU_100ms_PDU07.secoc_error);break; //CCU_100ms_PDU07
//    case 0x382:  PreProcess_PDU(shortID, aPayloadLength, data, @Msg_Error::FDR_100ms_PDU01.rolling_counter_delta, @Msg_Error::FDR_100ms_PDU01.checksum_error, @Msg_Error::FDR_100ms_PDU01.secoc_error);break; //FDR_100ms_PDU01
//    case 0x32B:  PreProcess_PDU(shortID, aPayloadLength, data, @Msg_Error::IAM_100ms_PDU18.rolling_counter_delta, @Msg_Error::IAM_100ms_PDU18.checksum_error, @Msg_Error::IAM_100ms_PDU18.secoc_error);break; //IAM_100ms_PDU18
//    case 0x3CE:  PreProcess_PDU(shortID, aPayloadLength, data, @Msg_Error::IAM_ZONE_100ms_PDU56.rolling_counter_delta, @Msg_Error::IAM_ZONE_100ms_PDU56.checksum_error, @Msg_Error::IAM_ZONE_100ms_PDU56.secoc_error);break; //IAM_ZONE_100ms_PDU56
//    case 0x385:  PreProcess_PDU(shortID, aPayloadLength, data, @Msg_Error::ICBVC_100ms_PDU78.rolling_counter_delta, @Msg_Error::ICBVC_100ms_PDU78.checksum_error, @Msg_Error::ICBVC_100ms_PDU78.secoc_error);break; //ICBVC_100ms_PDU78
//    case 0x38B:  PreProcess_PDU(shortID, aPayloadLength, data, @Msg_Error::ICBVC_100ms_PDU80.rolling_counter_delta, @Msg_Error::ICBVC_100ms_PDU80.checksum_error, @Msg_Error::ICBVC_100ms_PDU80.secoc_error);break; //ICBVC_100ms_PDU80
//    case 0x309:  PreProcess_PDU(shortID, aPayloadLength, data, @Msg_Error::RZCU_100ms_PDU10.rolling_counter_delta, @Msg_Error::RZCU_100ms_PDU10.checksum_error, @Msg_Error::RZCU_100ms_PDU10.secoc_error);break; //RZCU_100ms_PDU10
//    case 0x12A:  PreProcess_PDU(shortID, aPayloadLength, data, @Msg_Error::IAM_ZONE_20ms_PDU10.rolling_counter_delta, @Msg_Error::IAM_ZONE_20ms_PDU10.checksum_error, @Msg_Error::IAM_ZONE_20ms_PDU10.secoc_error);break; //IAM_ZONE_20ms_PDU10
//    case 0xB3:  PreProcess_PDU(shortID, aPayloadLength, data, @Msg_Error::IAM_ZONE_Sporadic_PDU01.rolling_counter_delta, @Msg_Error::IAM_ZONE_Sporadic_PDU01.checksum_error, @Msg_Error::IAM_ZONE_Sporadic_PDU01.secoc_error);break; //IAM_ZONE_Sporadic_PDU01
//    case 0x9F:  PreProcess_PDU(shortID, aPayloadLength, data, @Msg_Error::IAM_ZONE_Sporadic_PDU02.rolling_counter_delta, @Msg_Error::IAM_ZONE_Sporadic_PDU02.checksum_error, @Msg_Error::IAM_ZONE_Sporadic_PDU02.secoc_error);break; //IAM_ZONE_Sporadic_PDU02
//    case 0x7D:  PreProcess_PDU(shortID, aPayloadLength, data, @Msg_Error::IAM_ZONE_Sporadic_PDU03.rolling_counter_delta, @Msg_Error::IAM_ZONE_Sporadic_PDU03.checksum_error, @Msg_Error::IAM_ZONE_Sporadic_PDU03.secoc_error);break; //IAM_ZONE_Sporadic_PDU03
//    case 0x24F:  PreProcess_PDU(shortID, aPayloadLength, data, @Msg_Error::ICBVC_50ms_PDU55.rolling_counter_delta, @Msg_Error::ICBVC_50ms_PDU55.checksum_error, @Msg_Error::ICBVC_50ms_PDU55.secoc_error);break; //ICBVC_50ms_PDU55
//    case 0x0: 
//      switch(longID)
//      {
//        case 0x72505: PreProcess_PDU(longID, aPayloadLength, data, @Msg_Error::EPS_10ms_PDU01.rolling_counter_delta, @Msg_Error::EPS_10ms_PDU01.checksum_error, @Msg_Error::EPS_10ms_PDU01.secoc_error); break; //EPS_10ms_PDU01
//        case 0x72506: PreProcess_PDU(longID, aPayloadLength, data, @Msg_Error::EPS_10ms_PDU02.rolling_counter_delta, @Msg_Error::EPS_10ms_PDU02.checksum_error, @Msg_Error::EPS_10ms_PDU02.secoc_error); break; //EPS_10ms_PDU02
//        case 0x72514: PreProcess_PDU(longID, aPayloadLength, data, @Msg_Error::EPS_10ms_PDU05.rolling_counter_delta, @Msg_Error::EPS_10ms_PDU05.checksum_error, @Msg_Error::EPS_10ms_PDU05.secoc_error); break; //EPS_10ms_PDU05
//        case 0x96010: PreProcess_PDU(longID, aPayloadLength, data, @Msg_Error::RZCU_10ms_PDU02.rolling_counter_delta, @Msg_Error::RZCU_10ms_PDU02.checksum_error, @Msg_Error::RZCU_10ms_PDU02.secoc_error); break; //RZCU_10ms_PDU02
//        case 0x96002: PreProcess_PDU(longID, aPayloadLength, data, @Msg_Error::RZCU_10ms_PDU01.rolling_counter_delta, @Msg_Error::RZCU_10ms_PDU01.checksum_error, @Msg_Error::RZCU_10ms_PDU01.secoc_error); break; //RZCU_10ms_PDU01
//        case 0x960105: PreProcess_PDU(longID, aPayloadLength, data, @Msg_Error::RZCU_20ms_PDU06.rolling_counter_delta, @Msg_Error::RZCU_20ms_PDU06.checksum_error, @Msg_Error::RZCU_20ms_PDU06.secoc_error); break; //RZCU_20ms_PDU06
//        case 0x31003: PreProcess_PDU(longID, aPayloadLength, data, @Msg_Error::EPS_010ms_PDU03.rolling_counter_delta, @Msg_Error::EPS_010ms_PDU03.checksum_error, @Msg_Error::EPS_010ms_PDU03.secoc_error); break; //EPS_010ms_PDU03
//        case 0x72507: PreProcess_PDU(longID, aPayloadLength, data, @Msg_Error::IBS_10ms_PDU04.rolling_counter_delta, @Msg_Error::IBS_10ms_PDU04.checksum_error, @Msg_Error::IBS_10ms_PDU04.secoc_error); break; //IBS_10ms_PDU04
//        case 0x72509: PreProcess_PDU(longID, aPayloadLength, data, @Msg_Error::IBS_20ms_PDU10.rolling_counter_delta, @Msg_Error::IBS_20ms_PDU10.checksum_error, @Msg_Error::IBS_20ms_PDU10.secoc_error); break; //IBS_20ms_PDU10
//        case 0x72510: PreProcess_PDU(longID, aPayloadLength, data, @Msg_Error::IBS_20ms_PDU13.rolling_counter_delta, @Msg_Error::IBS_20ms_PDU13.checksum_error, @Msg_Error::IBS_20ms_PDU13.secoc_error); break; //IBS_20ms_PDU13
//        case 0x12358: PreProcess_PDU(longID, aPayloadLength, data, @Msg_Error::ESS_100ms_PDU58.rolling_counter_delta, @Msg_Error::ESS_100ms_PDU58.checksum_error, @Msg_Error::ESS_100ms_PDU58.secoc_error); break; //ESS_100ms_PDU58
//        default:break;  
//      }
//      break;
//    default:break;
//  }
//
//  return 1;
//}

